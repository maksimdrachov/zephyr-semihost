## CMakeLists.txt
```
# SPDX-License-Identifier: Apache-2.0

cmake_minimum_required(VERSION 3.20.0)

# Set flags for semihost
set(CMAKE_EXE_LINKER_FLAGS "${CMAKE_EXE_LINKER_FLAGS} -Wl,-lrdimon")
set(CMAKE_C_FLAGS "${CMAKE_C_FLAGS} --specs=rdimon.specs")

find_package(Zephyr REQUIRED HINTS $ENV{ZEPHYR_BASE})
project(semihost)

if(CONFIG_CPP)
  message(STATUS "adding main.cpp")
  FILE(GLOB app_sources src/*.cpp src/*.hpp)
  target_sources(app PRIVATE ${app_sources})
else()
  message(STATUS "adding main.c")
  FILE(GLOB app_sources src/*.c src/*.h)
  target_sources(app PRIVATE ${app_sources})
endif()

# FILE(GLOB app_sources src/*.c src/*.h)
# target_sources(app PRIVATE ${app_sources})
zephyr_include_directories(include)
zephyr_sources(include/semihost_extra.c)
```

## prj.conf
```kconfig
CONFIG_ZTEST=y
CONFIG_ZTEST_NEW_API=y

# Semihosting related
CONFIG_SEMIHOST=y
CONFIG_ZTEST_TC_UTIL_USER_OVERRIDE=y

# C++ related
CONFIG_CPP=y
CONFIG_NEWLIB_LIBC=y
```

## src/main.c
```c
/*
 * Copyright (c) 2022, Commonwealth Scientific and Industrial Research
 * Organisation (CSIRO) ABN 41 687 119 230.
 *
 * SPDX-License-Identifier: Apache-2.0
 */

#include <zephyr/ztest.h>
#include <zephyr/arch/common/semihost.h>
#include <zephyr/kernel.h>

ZTEST(semihost, test_file_ops)
{
    zassert_true(true, "Some test failed");
    printk("test finished!\n");

    // semihost_exec(0x18, 0);
}

ZTEST_SUITE(semihost, NULL, NULL, NULL, NULL, NULL);
```

## include/semihost_extra.c
```c
#include <string.h>
#include <zephyr/kernel.h>
#include <zephyr/arch/common/semihost.h>

// This is the semihosting command to execute a system command (isn't defined in semihost.c)
struct semihost_system_args
{
    const char* cmd;
    long        len;
} __packed;

long semihost_system(const char* cmd)
{
    struct semihost_system_args args = {
        .cmd = cmd,
        .len = strlen(cmd),
    };

    return semihost_exec(SEMIHOST_SYSTEM, &args);
}

int semihost_log(const char* fmt, ...)
{
    char buf[256];
    printk("semihost_log 1\n");
    va_list args;
    va_start(args, fmt);
    int len = vsnprintk(buf, sizeof(buf), fmt, args);
    va_end(args);
    printk("semihost_log 2\n");

    const char* path = "./test_log.bin";
    printk("semihost_log 3\n");
    long fd = semihost_open(path, SEMIHOST_OPEN_A);
    printk("semihost_log 4\n");
    long len_long = semihost_write(fd, buf, len);
    printk("semihost_log 5\n");
    semihost_close(fd);
    printk("semihost_log 6\n");
    int write_len = (int) len_long;
    return write_len;
}
```

## include/semihost_extra.h
```c
#ifndef SEMIHOST_EXTRA_H
#define SEMIHOST_EXTRA_H

long semihost_system(const char* cmd);

int semihost_log(const char* fmt, ...);

#endif  // SEMIHOST_EXTRA_H
```

## include/tc_util_user_override.h
```c
/*
 * Copyright (c) 2019 Nordic Semiconductor ASA
 *
 * SPDX-License-Identifier: Apache-2.0
 */

#ifndef __TC_UTIL_USER_OVERRIDE_H__
#define __TC_UTIL_USER_OVERRIDE_H__

/* This header provides a sample user override of various tc_util.h defines. */
#include "semihost_extra.h"

// // custom PRINT_DATA
#define PRINT_DATA(fmt, ...) semihost_log(fmt, ##__VA_ARGS__)
// #define TC_SUMMARY_PRINT(fmt, ...) semihost_log(fmt, ##__VA_ARGS__)

// /* Example: Reduce vertical line verbosity by
//  * redefining the separator to nothing.
//  */
// #define PRINT_LINE

// /* Example: Prepend test cases with a counter. */
// #define TC_START(original)                          \
//     do                                              \
//     {                                               \
//         static int count;                           \
//         printk("%d: Test [%s]", ++count, original); \
//     } while (0)

// /* Example: Change result string output formats. */
// #define TC_PASS_STR "Customized PASS"
// #define TC_FAIL_STR "Customized FAIL"
// #define TC_SKIP_STR "Customized SKIP"

// /* Example: Also count the number of pass/fail/skips and display it. */
// #define Z_TC_END_RESULT(result, s)                                         \
//     do                                                                     \
//     {                                                                      \
//         static int result_keeper[3] = {0};                                 \
//         result_keeper[result]++;                                           \
//         printk(" reported %s - %s in 0 seconds(No time counted) no. %d\n", \
//                TC_RESULT_TO_STR(result),                                   \
//                s,                                                          \
//                result_keeper[result]);                                     \
//     } while (0)

#endif /* __TC_UTIL_USER_OVERRIDE_H__ */
```
